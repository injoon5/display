## firmware/Kconfig.projbuild
```kconfig
menu "Matrix Panel firmware"

config MX_HOMESPAN
    bool "Enable legacy HomeSpan stub (UNSUPPORTED — requires Arduino)"
    default n
    help
        Dead path. HomeSpan needs Arduino-as-component, which this project rejects.
        Leave disabled. Prefer Shortcuts/dashboard → /api/* today, or an ESP-IDF-native
        HAP stack later. Do not enable this option.

config MX_OTA_ALLOW_UNSIGNED
    int "Allow demo/unsigned OTA signatures (1=yes, 0=no)"
    default 1
    range 0 1
    help
        Accept demo OTA signatures: exactly 64 hex characters (deterministic
        sha256 stand-in from release.sh) or the literal ED25519_SIGNATURE_TODO.
        Set to 0 for production builds that require a baked factory public key.

endmenu
```

## firmware/sdkconfig.defaults
```kconfig
CONFIG_ESPTOOLPY_FLASHSIZE_8MB=y
CONFIG_PARTITION_TABLE_CUSTOM=y
CONFIG_PARTITION_TABLE_CUSTOM_FILENAME="partitions.csv"

CONFIG_ESP32S3_SPIRAM_SUPPORT=y
CONFIG_SPIRAM=y
CONFIG_SPIRAM_MODE_OCT=y
CONFIG_SPIRAM_SPEED_80M=y

CONFIG_SPIFFS_MAX_PARTITIONS=1
CONFIG_SPIFFS_PAGE_CHECK=y
CONFIG_SPIFFS_GC_MAX_RUNS=64

CONFIG_ESP_MAIN_TASK_STACK_SIZE=8192
CONFIG_FREERTOS_HZ=1000

CONFIG_BT_ENABLED=y
CONFIG_BT_BLUEDROID_ENABLED=y
CONFIG_WIFI_PROV_BLE_FORCE_ENCRYPTION=y
CONFIG_MX_HOMESPAN=n
CONFIG_MX_OTA_ALLOW_UNSIGNED=1
```
